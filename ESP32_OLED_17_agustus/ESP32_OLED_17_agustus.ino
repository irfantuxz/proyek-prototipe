/*
Judul : player lagu Indonesia Raya tiap jam 10.00

Modul / komponen :
Arduino Uno
Modul RTC DS1302
Modul MP3 Player modifikasi jumper
LCD I2C 128x64 (opsional)

oleh : Irfan TuxZ (WhatsApp: 089-6715-06277)
*/
#include <MD_YX5300.h>
#include <MD_UISwitch.h>
#include <SoftwareSerial.h>
// Import Library
#include <RtcDS1302.h>
// Pin Modul RTC DS1302:
// DS1302 CLK --> 7
// DS1302 DAT --> 6
// DS1302 RST --> 5
// DS1302 VCC --> 3.3v - 5v
// DS1302 GND --> GND
ThreeWire myWire(26, 27, 25);  // DATA, CLK, RST
RtcDS1302<ThreeWire> Rtc(myWire);
RtcDateTime timeNow;

#define SSD1306_NO_SPLASH
#include <Adafruit_SSD1306.h>
#include <Adafruit_GFX.h>
#include <Fonts/CalibriBold8pt.h>
#include <Fonts/CalibriBold16pt.h>
#define SCREEN_WIDTH 128     // OLED display width, in pixels
#define SCREEN_HEIGHT 64     // OLED display height, in pixels
#define OLED_RESET -1        // Reset pin # (or -1 if sharing Arduino reset pin)
#define SCREEN_ADDRESS 0x3C  ///< See datasheet for Address; 0x3D or 0x3D
Adafruit_SSD1306 display(SCREEN_WIDTH, SCREEN_HEIGHT, &Wire, OLED_RESET);

// Const : membuat ID tiap pin Arduino
// #define MP3_GND_pin  2  // pin menuju ground (bat-) modul MP3 player
// #define MP3_PWR_pin  3  // pin menuju power +5V (bat+) modul MP3 player
// #define MP3_play_pin 4  // pin menuju tombol PLAY modul MP3 player
// const byte MP3_GND_pin = 2;   // pin menuju ground (bat-) modul MP3 player
// const byte MP3_PWR_pin = 3;   // pin menuju power +5V (bat+) modul MP3 player
// const byte MP3_play_pin = 4;  // pin menuju tombol PLAY modul MP3 player
// const byte Display_pin = 12;
// const byte LED_pin = 13;
#define MP3_POWER 32

// const byte btnPWR = 8;
// const byte btnINP = 9;

int valA0;

bool statusLED = LOW;
bool beginDisplay = false;
//int valA1, valA2;
//byte tipeDisplay = 0;  // 0:none (A1-float , A2-float), 1:LED (A1-5V+ , A2-float) 2:Display (A1-float , A2-5V+)

// Variable
char inChar;               // untuk menerima character Serial com
String inString;           // untuk menyimpan kata dari Serial com
bool musikPlayed = false;  // variabel kondisi musik
bool buttonState = 0;      // variabel kondisi tombol
unsigned long milisTombol = 0;
bool forcedPlay = false;
bool bolehTombol = true;

// menyimpan waktu alarm
String aString = "10:00";
byte setOnJam = 10;
byte setOnMenit = 0;
byte setOnDetik = 0;
byte setOffJam = 10;
byte setOffMenit = 1;
byte setOffDetik = 1;

byte setFOffJam   = 0;
byte setFOffMenit = 0;
byte setFOffDetik = 0;

// Var cek waktu
unsigned long prevMillis = 0;
unsigned long interval = 500 - 1;

bool calib = true;

// 'alarm_BMP', 16x16px
const unsigned char icon_alarm[] PROGMEM = {
  0x00, 0x00, 0x33, 0xcc, 0x6c, 0x36, 0x58, 0x1a, 0x31, 0x8c, 0x21, 0x84, 0x41, 0x82, 0x41, 0xe2,
  0x40, 0xe2, 0x40, 0x02, 0x60, 0x06, 0x30, 0x0c, 0x18, 0x18, 0x0c, 0x30, 0x37, 0xec, 0x00, 0x00
};
// 'flag_BMP_OK1', 16x16px
const unsigned char icon_flag1[] PROGMEM = {
  0x0f, 0xc1, 0xbf, 0xff, 0xbf, 0xff, 0x5f, 0xff, 0x5e, 0x1d, 0x28, 0x01, 0x28, 0x01, 0x28, 0x01,
  0x14, 0x39, 0x17, 0xc6, 0x1b, 0x00, 0x08, 0x00, 0x0c, 0x00, 0x04, 0x00, 0x06, 0x00, 0x02, 0x00
};
// 'flag_BMP_OK2', 16x16px
const unsigned char icon_flag2[] PROGMEM = {
  0x30, 0xfc, 0xbf, 0xff, 0xbf, 0xff, 0x5f, 0xff, 0x5f, 0xe1, 0x2a, 0x01, 0x28, 0x01, 0x28, 0x01,
  0x14, 0x0f, 0x17, 0xf8, 0x1c, 0x60, 0x08, 0x00, 0x0c, 0x00, 0x04, 0x00, 0x06, 0x00, 0x02, 0x00
};

// 'Flag1_32px', 32x32px
const unsigned char flag1_32px [] PROGMEM = {
	0x00, 0x3f, 0xf0, 0x03, 0x01, 0xff, 0xfc, 0x07, 0x07, 0xff, 0xff, 0xff, 0xbf, 0xff, 0xff, 0xff, 
	0xdf, 0xff, 0xff, 0xff, 0xdf, 0xff, 0xff, 0xff, 0x6f, 0xff, 0xff, 0xff, 0x6f, 0xff, 0xff, 0xfd, 
	0x37, 0xff, 0x07, 0xf9, 0x37, 0xf8, 0x00, 0xe1, 0x1b, 0xe0, 0x00, 0x01, 0x1b, 0xc0, 0x00, 0x01, 
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	0x00, 0x1c, 0x00, 0x00, 0x00, 0x1c, 0x00, 0x00, 0x00, 0x0e, 0x00, 0x00, 0x00, 0x0e, 0x00, 0x00
};
// 'Flag2_32px', 32x32px
const unsigned char flag2_32px [] PROGMEM = {
	0x00, 0x00, 0x00, 0x00, 0x00, 0x00, 0x00, 0x00, 0x00, 0x00, 0x07, 0xf0, 0xbc, 0x00, 0x3f, 0xfc, 
	0xdf, 0x01, 0xff, 0xff, 0xdf, 0xff, 0xff, 0xff, 0x6f, 0xff, 0xff, 0xff, 0x6f, 0xff, 0xff, 0xff, 
	0x37, 0xff, 0xff, 0xff, 0x37, 0xff, 0xff, 0xff, 0x1b, 0xff, 0xff, 0x0f, 0x1b, 0xff, 0xf8, 0x03, 
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	0x00, 0x1c, 0x00, 0x00, 0x00, 0x1c, 0x00, 0x00, 0x00, 0x0e, 0x00, 0x00, 0x00, 0x0e, 0x00, 0x00
};

// 'images (2)', 128x64px
const unsigned char proklamasi [] PROGMEM = {
	0x00, 0x00, 0x00, 0x00, 0x00, 0x00, 0x00, 0x00, 0x00, 0x00, 0x00, 0x00, 0x00, 0x00, 0x00, 0x00, 
	0x49, 0x24, 0x92, 0x49, 0x24, 0x92, 0x49, 0x24, 0x92, 0x49, 0x24, 0x92, 0x49, 0x24, 0x92, 0x49, 
	0x24, 0x92, 0x49, 0x24, 0x92, 0x49, 0x24, 0x92, 0x49, 0x24, 0x92, 0x49, 0x24, 0x92, 0x49, 0x24, 
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	0x11, 0x20, 0x88, 0x01, 0x05, 0xf0, 0x84, 0x00, 0x07, 0xfe, 0xfb, 0xc0, 0x00, 0x00, 0x5f, 0x6f
};

// 'download (2)', 128x64px
const unsigned char teksProk [] PROGMEM = {
	0x00, 0x00, 0x00, 0x00, 0x00, 0x00, 0x00, 0x00, 0x00, 0x00, 0x00, 0x00, 0x00, 0x00, 0x00, 0x00, 
	0x00, 0x00, 0x00, 0x00, 0x00, 0x00, 0x00, 0x00, 0x00, 0x00, 0x00, 0x00, 0x00, 0x00, 0x00, 0x00, 
	0x00, 0x00, 0x00, 0x00, 0x00, 0x00, 0x00, 0x00, 0x00, 0x00, 0x00, 0x00, 0x00, 0x00, 0x00, 0x00, 
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	0x00, 0x00, 0x00, 0x00, 0x00, 0x00, 0x00, 0x00, 0x00, 0x00, 0x00, 0x00, 0x00, 0x00, 0x00, 0x00
};


#define countof(a) (sizeof(a) / sizeof(a[0]))
void printDateTime(const RtcDateTime& dt) {
  char datestring[26];
  snprintf_P(datestring,
             countof(datestring),
             PSTR("%02u-%02u-%04u %02u:%02u:%02u"),
             dt.Day(),
             dt.Month(),
             dt.Year(),
             dt.Hour(),
             dt.Minute(),
             dt.Second());
  Serial.println(datestring);
}

void printCenter(const String buf, int x, int y) {
  int16_t x1, y1;
  uint16_t w, h;
  display.getTextBounds(buf, x, y, &x1, &y1, &w, &h);
  display.setCursor((x - w / 2) + (128 / 2), y + h);
  display.print(buf);
}

void setup() {
  // Inisiasi serial com
  Serial.begin(115200);
  while (!Serial) { ; }
  Serial.flush();

  // inisiasi pin output:
  // pinMode(Display_pin, OUTPUT);
  // pinMode(LED_pin, OUTPUT);
  // pinMode(MP3_GND_pin, OUTPUT);
  // pinMode(MP3_PWR_pin, OUTPUT);
  // pinMode(MP3_play_pin, OUTPUT);
  // pinMode(btnPWR, OUTPUT);
  // pinMode(btnINP, INPUT);
  pinMode(MP3_POWER, OUTPUT);

  // SSD1306_SWITCHCAPVCC = generate display voltage from 3.3V internally
  if (!display.begin(SSD1306_SWITCHCAPVCC, SCREEN_ADDRESS)) {
    Serial.println(F("SSD1306 allocation failed"));
  } else {
    beginDisplay = true;
    display.flush();
    display.clearDisplay();
    display.setTextColor(SSD1306_WHITE);
    display.setTextSize(1);
    display.setFont(&CalibriBold8pt);
    printCenter("- TuxZ -", 0, 28);
    display.display();
  }

  // inisiasi status pin
  // digitalWrite(Display_pin, beginDisplay);
  // digitalWrite(LED_pin, LOW);
  // digitalWrite(MP3_GND_pin, LOW);
  // digitalWrite(MP3_PWR_pin, LOW);
  // digitalWrite(MP3_play_pin, HIGH);
  // digitalWrite(btnPWR, LOW);
  // digitalWrite(btnINP, HIGH);

  // waktu
  Rtc.Begin();

  RtcDateTime compiled = RtcDateTime("Aug 17 2024","09:59:55");
  printDateTime(compiled);

  if (!Rtc.IsDateTimeValid()) {
    // Common Causes:
    //    1) first time you ran and the device wasn't running yet
    //    2) the battery on the device is low or even missing
    Serial.println(F("RTC tidak valid!"));
    Rtc.SetDateTime(compiled);
  }

  if (Rtc.GetIsWriteProtected()) {
    Serial.println(F("RTC write protected, enabling.."));
    Rtc.SetIsWriteProtected(false);
  }

  if (!Rtc.GetIsRunning()) {
    Serial.println(F("RTC not running, starting.."));
    Rtc.SetIsRunning(true);
  }

  RtcDateTime now = Rtc.GetDateTime();
  if (now < compiled) {
    Serial.println(F("RTC is older! Updating.."));
    Rtc.SetDateTime(compiled);
  } else if (now > compiled) {
    Serial.println(F("RTC is newer. OK"));
  } else if (now == compiled) {
    Serial.println(F("RTC is same. OK"));
  }
    Rtc.SetDateTime(compiled);
}

void loop() {
  // menerima komunikasi Serial com
  inString = "";
  if (Serial.available() > 0) {
    inChar = Serial.read();
    inString += (char)inChar;
    //Serial.println(inString); //echo RX TX

    // if (inString == "r") {
    //   valA1 = analogRead(A1);
    //   valA2 = analogRead(A2);
    //   //Serial.println(F("A1=") + (String)valA1 + F(" A2=") + (String)valA2);
    //   Serial.println((String)valA1 + (String)valA2);
    // }
    // if (inString == "c"){
    //   if(beginDisplay) Serial.println(F("Display OK"));
    //   else{
    //     if (!display.begin(SSD1306_SWITCHCAPVCC, SCREEN_ADDRESS)) {
    //     Serial.println(F("SSD1306 allocation failed"));
    //     }
    //   }
    // }

    if (inString == "p") {
      musikPlayed = false;
      forcedPlay = true;
    }

    if (inString == "o") {
      musikPlayed = true;
      forcedPlay = true;
    }

    // if (inString == "x") {
    //   Serial.println("A0:"+ (String)valA0);
    // }

    if (inString == "s") {
      inString = Serial.readStringUntil('\n');
      inString.trim();
      //Serial.println(inString);
      RtcDateTime updateNow(inString.substring(6, 10).toInt(),    //Year
                            inString.substring(3, 5).toInt(),     //Month
                            inString.substring(0, 2).toInt(),     //Day
                            inString.substring(11, 13).toInt(),   //Hour
                            inString.substring(14, 16).toInt(),   //Minute
                            inString.substring(17, 19).toInt());  //Second
      if (updateNow.IsValid()) {
        Rtc.SetDateTime(updateNow);
        Serial.print(F("Update DateTime:"));
        timeNow = Rtc.GetDateTime();
        printDateTime(timeNow);
      } else {
        Serial.print(F("Fail update:"));
        printDateTime(timeNow);
      }
      //Serial.println(F("charge:"+String(Rtc.GetTrickleChargeSettings()));
    }

    if (inString == "a") {
      inString = Serial.readStringUntil('\n');
      inString.trim();
      byte jamA = inString.substring(0, 2).toInt();
      byte minA = inString.substring(3, 5).toInt();

      if (!isnan(jamA) && !isnan(minA)) {  //only accept Number
        Serial.print(F("Set Alarm OK:"));
        Serial.println(inString);
        aString = inString;

        if (minA < 1) {
          setOnJam = jamA - 1;
        } else {
          setOnJam = jamA;
        }
        setOnMenit = 60 + minA - 1;
        if (setOnMenit > 59) setOnMenit -= 60;
        //setOnDetik  = 57;

        if (minA > 58) {
          setOffJam = jamA + 1;
        } else {
          setOffJam = jamA;
        }
        setOffMenit = minA + 2;
        if (setOffMenit > 59) setOffMenit -= 60;
        //setOffDetik = 48;
        //Serial.println(F("DEBUG:" + (String)setOnJam + ":" + (String)setOnMenit + ":" + (String)setOnDetik + " " + (String)setOffJam + ":" + (String)setOffMenit + ":" + (String)setOffDetik);
      } else {
        //Serial.println(F("Set Alarm ERROR:")); //+ inString + "+DEBUG=" + (String)jamA + ":" + (String)minA);
        Serial.print(F("Set Alarm ERROR"));
      }
    }

    if (inString == "z") {
      //Serial.println(F("Alarm:") + (String)setOnJam + F(":") + (String)setOnMenit + F(":") + (String)setOnDetik + F(" ") + (String)setOffJam + F(":") + (String)setOffMenit + F(":") + (String)setOffDetik);
      Serial.print(F("Alarm: "));
      Serial.println(aString);
    }
    //-- End Serial com input ---------------------------//
  }

    // if (digitalRead(btnINP) == LOW) {
    //   if (bolehTombol){
    //     bolehTombol = false;
    //     milisTombol = millis();
    //     //musikPlayed = !musikPlayed;
    //     forcedPlay = true;
    //     Serial.println(F("tombol ditekan"));
    //   }
    // } else {
    //   if (millis() > milisTombol + 3000){
    //     bolehTombol = true;
    //   }
    // }

    // valA0 = analogRead(A0);
    // if (valA0 > 1020){
    //   if (bolehTombol){
    //     Serial.println("A0:"+ (String)valA0);
    //     bolehTombol = false;
    //     milisTombol = millis();
    //     //musikPlayed = !musikPlayed;
    //     forcedPlay = true;
    //     //Serial.println(F("tombol ditekan"));
    //   }
    // } else {
    //   if (millis() > milisTombol + 3000){
    //     bolehTombol = true;
    //   }
    // }

    // if (inString == "x") {
    //   Serial.println("A0:"+ (String)valA0);
    // }
    
    if(forcedPlay){
      forcedPlay = false;
      musikPlayed = !musikPlayed;
      if(musikPlayed){
        setFOffJam   = timeNow.Hour() + 0;
        setFOffMenit = timeNow.Minute() + 1;
        setFOffDetik = timeNow.Second() + 51;
        if (setFOffDetik > 59){
          setFOffDetik -= 60;
          setFOffMenit += 1;
        }
        if (setFOffMenit > 59){
          setFOffMenit -= 60;
          setFOffJam += 1;
        }
        if (setFOffJam > 23){
          setFOffJam -= 24;
        }
        // digitalWrite(MP3_PWR_pin, HIGH);
        // delay(700);
        // digitalWrite(MP3_play_pin, LOW);
        // delay(200);
        // digitalWrite(MP3_play_pin, HIGH);
      }else{
        // digitalWrite(MP3_play_pin, LOW);
        // delay(200);
        // digitalWrite(MP3_play_pin, HIGH);
        // delay(200);
        // digitalWrite(MP3_PWR_pin, LOW);
      }
    }

  // print waktu tiap 1s
  if (millis() - prevMillis >= interval) {
    statusLED = !statusLED;
    prevMillis = millis();
    timeNow = Rtc.GetDateTime();
    if (!timeNow.IsValid()) {
      Serial.println(F("RTC tidak dapat terbaca!"));
    } else {
      //if (timeNow.Second() % 10 == 0) printDateTime(timeNow);
      if (timeNow.Minute() == 30) {
        if (timeNow.Second() == 10) {
          if (timeNow.Hour() % 2 == 0) {
            if (calib) {
              timeNow = timeNow - 1;
              Rtc.SetDateTime(timeNow);
              calib = false;
              Serial.print(F("Calibrasi :"));
              printDateTime(timeNow);
            }
          }
        } else if (timeNow.Second() == 20) {
          if (timeNow.Hour() % 2 == 0) {
            calib = true;
          }
        }
      }

      // Mainkan musik MP3 pada jam menit detik yg disetel
      if (!musikPlayed) {
        if (timeNow.Hour() == setOnJam) {
          if (timeNow.Minute() == setOnMenit) {
            if (timeNow.Second() == setOnDetik) {
              // digitalWrite(MP3_PWR_pin, HIGH);
              // delay(700);
              // digitalWrite(MP3_play_pin, LOW);
              // delay(200);
              // digitalWrite(MP3_play_pin, HIGH);
              digitalWrite(MP3_POWER, HIGH);
              musikPlayed = true;
            }
          }
        }
      }

      // matikan MP3 player pada jam menit detik yg disetel
      if (musikPlayed) {
        if (timeNow.Hour() == setOffJam) {
          if (timeNow.Minute() == setOffMenit) {
            if (timeNow.Second() == setOffDetik) {
              // digitalWrite(MP3_play_pin, LOW);
              // delay(200);
              // digitalWrite(MP3_play_pin, HIGH);
              // delay(200);
              // digitalWrite(MP3_PWR_pin, LOW);
              digitalWrite(MP3_POWER, LOW);
              musikPlayed = false;
            }
          }
        }
        if (timeNow.Hour() == setFOffJam) {
          if (timeNow.Minute() == setFOffMenit) {
            if (timeNow.Second() == setFOffDetik) {
              // digitalWrite(MP3_play_pin, LOW);
              // delay(200);
              // digitalWrite(MP3_play_pin, HIGH);
              // delay(200);
              // digitalWrite(MP3_PWR_pin, LOW);
              digitalWrite(MP3_POWER, LOW);
              musikPlayed = false;
              setFOffDetik = 0;
              setFOffMenit = 0;
              setFOffJam = 0;
            }
          }
        }
      }
    }

    // valA1 = analogRead(A1);
    // valA2 = analogRead(A2);
    // if (valA2 > 1020) tipeDisplay = 2;
    // else if (valA1 > 1020) tipeDisplay = 1;
    // else tipeDisplay = 0;

    //Tampilan Display
    // digitalWrite(LED_pin, statusLED);
    if (beginDisplay) {
      display.clearDisplay();
      timeNow = Rtc.GetDateTime();
      char datestring[11];
      snprintf_P(datestring,
                 countof(datestring),
                 PSTR("%02u/%02u/%04u"),
                 timeNow.Day(),
                 timeNow.Month(),
                 timeNow.Year());
      char timestring[10];
      snprintf_P(timestring,
                 countof(timestring),
                 PSTR("%02u:%02u:%02u"),
                 timeNow.Hour(),
                 timeNow.Minute(),
                 timeNow.Second());

      if(!musikPlayed){
          display.setFont(&CalibriBold8pt);
          printCenter(datestring, 0, 0);
          display.setFont(&CalibriBold16pt);
          printCenter(timestring, 0, 20);
          display.drawLine(2, 44, 125, 44, SSD1306_WHITE);
          display.setFont(&CalibriBold8pt);
          printCenter(aString, 0, 52);
          display.drawBitmap(14, 49, icon_alarm, 16, 16, WHITE);
          if (musikPlayed & statusLED)
            display.drawBitmap(97, 48, icon_flag2, 16, 16, WHITE);
          else
            display.drawBitmap(97, 48, icon_flag1, 16, 16, WHITE);

      }

      else{

        if (timeNow.Second() > 5 && timeNow.Second() < 25){
                display.drawBitmap(0, 0, proklamasi, 128, 64, WHITE);
        }else
        if (timeNow.Second() > 24 && timeNow.Second() < 40){
                display.drawBitmap(0, 0, teksProk, 128, 64, WHITE);
        }else{

            if (musikPlayed & statusLED)
              display.drawBitmap(47, 1, flag1_32px, 32, 32, WHITE);
            else
              display.drawBitmap(47, 1, flag2_32px, 32, 32, WHITE);
            display.drawLine(2, 35, 125, 35, SSD1306_WHITE);
            display.setFont(&CalibriBold8pt);
            printCenter(timestring, 0, 38);
            printCenter(datestring, 0, 48);

        }
      }

      display.display();
    }
  }
}